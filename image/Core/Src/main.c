/* USER CODE BEGIN Header */
/**
  ******************************************************************************
  * @file           : main.c
  * @brief          : ????
  ******************************************************************************
  */
/* USER CODE END Header */
/* Includes ------------------------------------------------------------------*/
#include "main.h"
#include "dma.h"
#include "i2c.h"
#include "spi.h"
#include "usart.h"
#include "gpio.h"
/* Private includes ----------------------------------------------------------*/
/* USER CODE BEGIN Includes */
#include <string.h>
/* USER CODE END Includes */

/* Private typedef -----------------------------------------------------------*/
/* USER CODE BEGIN PTD */
// ??????
typedef enum {
    MUSIC_STOP = 0,
    MUSIC_PLAYING,
    MUSIC_PAUSE,
    MUSIC_ERROR
} Music_StatusTypeDef;
/* USER CODE END PTD */

/* Private define ------------------------------------------------------------*/
/* USER CODE BEGIN PD */
#define TOTAL_IMAGES     8
#define IMG_WIDTH        240
#define IMG_HEIGHT       240
#define SINGLE_IMG_SIZE  (IMG_WIDTH * IMG_HEIGHT * 2) 
#define TEXT1_LEN        5
#define TEXT2_LEN        18
#define LCD_CS_PORT    GPIOB
#define LCD_CS_PIN     GPIO_PIN_0
#define LCD_RS_PORT    GPIOC
#define LCD_RS_PIN     GPIO_PIN_5
#define LCD_RST_PORT   GPIOC
#define LCD_RST_PIN    GPIO_PIN_4
#define FLASH_CS_PORT  GPIOC
#define FLASH_CS_PIN   GPIO_PIN_1
#define KEY_UP_PORT     GPIOE
#define KEY_UP_PIN      GPIO_PIN_0
#define KEY_DOWN_PORT   GPIOE
#define KEY_DOWN_PIN    GPIO_PIN_1
#define KEY_MUSIC_PORT  GPIOE
#define KEY_MUSIC_PIN   GPIO_PIN_2
#define KEY_SAFE_PORT   GPIOE
#define KEY_SAFE_PIN    GPIO_PIN_3
#define OLED_ADDR       0x78    
#define OLED_WIDTH      128
#define OLED_HEIGHT     64
#define FONT_WIDTH      16      
#define FONT_HEIGHT     16      
#define MP3_UART        &huart2
#define MP3_START_CODE  0x7E
#define MP3_END_CODE    0xEF
#define MP3_DEV_ADDR    0xFFFF  
#define MP3_RX_BUF_LEN  16      
/* USER CODE END PD */

/* Private macro -------------------------------------------------------------*/
/* USER CODE BEGIN PM */
#define READ_KEY_UP()      HAL_GPIO_ReadPin(KEY_UP_PORT, KEY_UP_PIN)
#define READ_KEY_DOWN()    HAL_GPIO_ReadPin(KEY_DOWN_PORT, KEY_DOWN_PIN)
#define READ_KEY_MUSIC()   HAL_GPIO_ReadPin(KEY_MUSIC_PORT, KEY_MUSIC_PIN)
#define READ_KEY_SAFE()    HAL_GPIO_ReadPin(KEY_SAFE_PORT, KEY_SAFE_PIN)
/* USER CODE END PM */

/* Private variables ---------------------------------------------------------*/
/* USER CODE BEGIN PV */
uint16_t line_buffer1[IMG_WIDTH] __attribute__((aligned(4)));
uint16_t line_buffer2[IMG_WIDTH] __attribute__((aligned(4)));
volatile uint8_t spi_dma_tx_complete = 0;

uint8_t current_img_index = 0;               
uint8_t safe_mode_flag = 0;                  
Music_StatusTypeDef music_status = MUSIC_STOP; 
const uint8_t Font_Text1[][32] = {
{0x00,0xFE,0x02,0x42,0x22,0x32,0x5E,0x92,0x52,0x32,0x12,0x02,0x02,0xFE,0x00,0x00,
 0x00,0xFF,0x42,0x42,0x42,0x51,0x55,0x64,0x69,0x41,0x42,0x42,0x42,0xFF,0x00,0x00},
{0x00,0x00,0x00,0xFE,0x20,0x20,0x20,0x20,0x20,0x3F,0x20,0x20,0x20,0x20,0x00,0x00,
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 0x08,0x08,0xF4,0x94,0x92,0x92,0xF1,0x00,0x01,0xF2,0x92,0x94,0x94,0xF8,0x08,0x00},
};

const uint8_t Font_Text2[][32] = {
{0x00,0x00,0xE2,0x82,0x82,0x82,0x82,0x82,0x82,0x82,0x82,0xFE,0x00,0x00,0x00,0x00,
 0x00,0x00,0x3F,0x40,0x40,0x40,0x40,0x40,0x40,0x40,0x40,0x40,0x40,0x78,0x00,0x00},
{0x40,0x40,0x42,0xCC,0x00,0x80,0x88,0x88,0xFF,0x88,0x88,0xFF,0x88,0x88,0x80,0x00,
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 0x00,0x00,0x00,0x33,0x00,0x00,0x00,0x00,0x00,0x00,0x00,0x00,0x00,0x00,0x00,0x00},
};

const uint8_t Font_ImageLine[][32] = {
{0x08,0x04,0x93,0x92,0x96,0x9A,0x92,0xFA,0x94,0x93,0x92,0x96,0xFA,0x02,0x02,0x00,
 0x40,0x40,0x47,0x24,0x24,0x14,0x0C,0xFF,0x04,0x04,0x24,0x44,0x24,0x1C,0x00,0x00},
{0x02,0xE2,0x22,0x22,0x3E,0x80,0x80,0xFF,0x80,0xA0,0x90,0x88,0x86,0x80,0x80,0x00,
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 0x00,0x80,0x60,0x1F,0x02,0x02,0x02,0x02,0x02,0x02,0xFE,0x00,0x00,0x00,0x00,0x00},
};

const uint8_t Font_MusicLine[][32] = {
{0x40,0x40,0x44,0x44,0x54,0x64,0x45,0x46,0x44,0x64,0x54,0x44,0x44,0x40,0x40,0x00,
 0x00,0x00,0x00,0xFF,0x49,0x49,0x49,0x49,0x49,0x49,0x49,0xFF,0x00,0x00,0x00,0x00},
{0x00,0x00,0xE0,0x9C,0x84,0x84,0x84,0xF4,0x82,0x82,0x83,0x82,0x80,0x80,0x00,0x00,
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 0x81,0x81,0x41,0x41,0x21,0x11,0x0D,0x03,0x0D,0x11,0x21,0x41,0x41,0x81,0x81,0x00},
};

const uint8_t Font_SafeLine[][32] = {
{0x80,0x90,0x8C,0x84,0x84,0x84,0xF5,0x86,0x84,0x84,0x84,0x84,0x94,0x8C,0x80,0x00,
 0x00,0x80,0x80,0x84,0x46,0x49,0x28,0x10,0x10,0x2C,0x23,0x40,0x80,0x00,0x00,0x00},
{0x80,0x80,0x40,0x20,0x50,0x48,0x44,0xC3,0x44,0x48,0x50,0x20,0x40,0x80,0x80,0x00,
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 0x81,0x81,0x41,0x41,0x21,0x11,0x0D,0x03,0x0D,0x11,0x21,0x41,0x41,0x81,0x81,0x00},
};

const uint8_t Font_ASCII[][16] = {
{0x00,0x00,0x10,0x10,0xF8,0x00,0x00,0x00,0x00,0x00,0x20,0x20,0x3F,0x20,0x20,0x00},
{0x00,0x70,0x08,0x08,0x08,0x08,0xF0,0x00,0x00,0x30,0x28,0x24,0x22,0x21,0x30,0x00},
{0x00,0x30,0x08,0x08,0x08,0x88,0x70,0x00,0x00,0x18,0x20,0x21,0x21,0x22,0x1C,0x00},
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{0x00,0x70,0x88,0x08,0x08,0x88,0x70,0x00,0x00,0x1C,0x22,0x21,0x21,0x22,0x1C,0x00},
};

const uint8_t NUM_MAP[8] = {0, 1, 2, 3, 4, 5, 6, 7}; 

uint8_t mp3_rx_buf[MP3_RX_BUF_LEN] = {0};  
volatile uint8_t mp3_rx_flag = 0;           
/* USER CODE END PV */

/* Private function prototypes -----------------------------------------------*/
void SystemClock_Config(void);
/* USER CODE BEGIN PFP */
void LCD_Init(void);
void LCD_Write_Cmd(uint8_t cmd);
void LCD_Write_Data(uint8_t data);
void LCD_Write_Data_16Bit(uint16_t data);
void LCD_Set_Window(uint16_t x1, uint16_t y1, uint16_t x2, uint16_t y2);
void W25QXX_Read(uint8_t* pBuffer, uint32_t ReadAddr, uint16_t NumByteToRead);
void Display_Image_From_Flash(uint32_t flash_addr);

void OLED_Init(void);
void OLED_WriteCmd(uint8_t cmd);
void OLED_WriteData(uint8_t data);
void OLED_Clear(void);
void OLED_ShowChar(uint8_t x, uint8_t y, const uint8_t (*font_array)[16], uint8_t font_idx);
void OLED_ShowChinese(uint8_t x, uint8_t y, const uint8_t (*font_array)[32], uint8_t font_idx);

uint8_t OLED_Get_Center_X(uint8_t text_len);
void OLED_Show_Normal_Line1(void);
void OLED_Show_Normal_Line2(void);
void OLED_Show_Normal_Line3(void);
void OLED_Show_Normal_Line4(void);
void OLED_Show_SafeMode_Text2_AutoWrap(void);
void OLED_Show_Normal_Mode(void);
void OLED_Show_Safe_Mode(void);

void MP3_Send_Cmd(uint8_t cmd, uint8_t *data, uint8_t data_len);
void MP3_Play(void);
void MP3_Pause(void);
void MP3_Stop(void);
void Key_Scan(void);
/* USER CODE END PFP */

/* Private user code ---------------------------------------------------------*/
/* USER CODE BEGIN 0 */

void LCD_Write_Cmd(uint8_t cmd) {
    HAL_GPIO_WritePin(LCD_CS_PORT, LCD_CS_PIN, GPIO_PIN_RESET);
    HAL_GPIO_WritePin(LCD_RS_PORT, LCD_RS_PIN, GPIO_PIN_RESET);
    HAL_SPI_Transmit(&hspi1, &cmd, 1, 100);
    HAL_GPIO_WritePin(LCD_CS_PORT, LCD_CS_PIN, GPIO_PIN_SET);
}

void LCD_Write_Data(uint8_t data) {
    HAL_GPIO_WritePin(LCD_CS_PORT, LCD_CS_PIN, GPIO_PIN_RESET);
    HAL_GPIO_WritePin(LCD_RS_PORT, LCD_RS_PIN, GPIO_PIN_SET);
    HAL_SPI_Transmit(&hspi1, &data, 1, 100);
    HAL_GPIO_WritePin(LCD_CS_PORT, LCD_CS_PIN, GPIO_PIN_SET);
}

void LCD_Write_Data_16Bit(uint16_t data) {
    uint8_t buf[2] = {data >> 8, data & 0xFF};
    HAL_GPIO_WritePin(LCD_CS_PORT, LCD_CS_PIN, GPIO_PIN_RESET);
    HAL_GPIO_WritePin(LCD_RS_PORT, LCD_RS_PIN, GPIO_PIN_SET);
    HAL_SPI_Transmit(&hspi1, buf, 2, 100);
    HAL_GPIO_WritePin(LCD_CS_PORT, LCD_CS_PIN, GPIO_PIN_SET);
}

void LCD_Init(void) {
    HAL_GPIO_WritePin(LCD_RST_PORT, LCD_RST_PIN, GPIO_PIN_RESET);
    HAL_Delay(200);
    HAL_GPIO_WritePin(LCD_RST_PORT, LCD_RST_PIN, GPIO_PIN_SET);
    HAL_Delay(120);
    
    LCD_Write_Cmd(0x11); HAL_Delay(120);
    LCD_Write_Cmd(0x36); LCD_Write_Data(0x00); 
    LCD_Write_Cmd(0x3A); LCD_Write_Data(0x05); 
    LCD_Write_Cmd(0xB2); LCD_Write_Data(0x0C); LCD_Write_Data(0x0C); 
    LCD_Write_Cmd(0xB7); LCD_Write_Data(0x35);
    LCD_Write_Cmd(0xBB); LCD_Write_Data(0x19);
    LCD_Write_Cmd(0xC0); LCD_Write_Data(0x2C);
    LCD_Write_Cmd(0xC2); LCD_Write_Data(0x01);
    LCD_Write_Cmd(0xC3); LCD_Write_Data(0x12);
    LCD_Write_Cmd(0xC4); LCD_Write_Data(0x20);
    LCD_Write_Cmd(0xC6); LCD_Write_Data(0x0F);
    LCD_Write_Cmd(0xD0); LCD_Write_Data(0xA4); LCD_Write_Data(0xA1);
    LCD_Write_Cmd(0xE0);
    LCD_Write_Data(0xD0); LCD_Write_Data(0x04); LCD_Write_Data(0x0D); LCD_Write_Data(0x11);
    LCD_Write_Data(0x13); LCD_Write_Data(0x2B); LCD_Write_Data(0x3F); LCD_Write_Data(0x54);
    LCD_Write_Data(0x4C); LCD_Write_Data(0x18); LCD_Write_Data(0x0D); LCD_Write_Data(0x0B);
    LCD_Write_Data(0x1F); LCD_Write_Data(0x23);
    LCD_Write_Cmd(0xE1);
    LCD_Write_Data(0xD0); LCD_Write_Data(0x04); LCD_Write_Data(0x0C); LCD_Write_Data(0x11);
    LCD_Write_Data(0x13); LCD_Write_Data(0x2C); LCD_Write_Data(0x3F); LCD_Write_Data(0x44);
    LCD_Write_Data(0x51); LCD_Write_Data(0x2F); LCD_Write_Data(0x1F); LCD_Write_Data(0x1F);
    LCD_Write_Data(0x20); LCD_Write_Data(0x23);
    LCD_Write_Cmd(0x21); 
    LCD_Write_Cmd(0x29); 
}

void LCD_Set_Window(uint16_t x1, uint16_t y1, uint16_t x2, uint16_t y2) {
    LCD_Write_Cmd(0x2A);
    LCD_Write_Data_16Bit(x1);
    LCD_Write_Data_16Bit(x2);
    LCD_Write_Cmd(0x2B);
    LCD_Write_Data_16Bit(y1);
    LCD_Write_Data_16Bit(y2);
    LCD_Write_Cmd(0x2C); 
}

void W25QXX_Read(uint8_t* pBuffer, uint32_t ReadAddr, uint16_t NumByteToRead) {
    uint8_t cmd[4];
    cmd[0] = 0x03;
    cmd[1] = (uint8_t)(ReadAddr >> 16); 
    cmd[2] = (uint8_t)(ReadAddr >> 8);  
    cmd[3] = (uint8_t)ReadAddr;         

    HAL_GPIO_WritePin(FLASH_CS_PORT, FLASH_CS_PIN, GPIO_PIN_RESET);
    HAL_SPI_Transmit(&hspi2, cmd, 4, 100);
    HAL_SPI_Receive(&hspi2, pBuffer, NumByteToRead, 1000);
    HAL_GPIO_WritePin(FLASH_CS_PORT, FLASH_CS_PIN, GPIO_PIN_SET);
}
void Display_Image_From_Flash(uint32_t flash_addr) {
    LCD_Set_Window(0, 0, IMG_WIDTH - 1, IMG_HEIGHT - 1);
    
    HAL_GPIO_WritePin(LCD_CS_PORT, LCD_CS_PIN, GPIO_PIN_RESET);
    HAL_GPIO_WritePin(LCD_RS_PORT, LCD_RS_PIN, GPIO_PIN_SET);
    W25QXX_Read((uint8_t*)line_buffer1, flash_addr, IMG_WIDTH * 2);

    for (int y = 0; y < IMG_HEIGHT; y++) {
        uint16_t *p_send = (y % 2 == 0) ? line_buffer1 : line_buffer2;
        uint16_t *p_read = (y % 2 == 0) ? line_buffer2 : line_buffer1;

        spi_dma_tx_complete = 0;
        HAL_SPI_Transmit_DMA(&hspi1, (uint8_t*)p_send, IMG_WIDTH * 2);

        if (y < IMG_HEIGHT - 1) {
            W25QXX_Read((uint8_t*)p_read, flash_addr + ((y+1) * IMG_WIDTH * 2), IMG_WIDTH * 2);
        }

        while(spi_dma_tx_complete == 0);
    }
    while (__HAL_SPI_GET_FLAG(&hspi1, SPI_FLAG_BSY) != RESET);

    HAL_GPIO_WritePin(LCD_CS_PORT, LCD_CS_PIN, GPIO_PIN_SET);
}

void HAL_SPI_TxCpltCallback(SPI_HandleTypeDef *hspi) {
    if(hspi->Instance == SPI1) {
        spi_dma_tx_complete = 1;
    }
}

void OLED_WriteCmd(uint8_t cmd) {
    HAL_I2C_Mem_Write(&hi2c1, OLED_ADDR, 0x00, I2C_MEMADD_SIZE_8BIT, &cmd, 1, 100);
}

void OLED_WriteData(uint8_t data) {
    HAL_I2C_Mem_Write(&hi2c1, OLED_ADDR, 0x40, I2C_MEMADD_SIZE_8BIT, &data, 1, 100);
}

void OLED_Init(void) {
    HAL_Delay(100);
    OLED_WriteCmd(0xAE); 
    OLED_WriteCmd(0xD5); 
    OLED_WriteCmd(0x80); 
    OLED_WriteCmd(0xA8); 
    OLED_WriteCmd(0x3F); 
    OLED_WriteCmd(0xD3); 
    OLED_WriteCmd(0x00);
    OLED_WriteCmd(0x40); 
    OLED_WriteCmd(0x8D); 
    OLED_WriteCmd(0x14); 
    OLED_WriteCmd(0x20); 
    OLED_WriteCmd(0x02); 
    OLED_WriteCmd(0xA1); 
    OLED_WriteCmd(0xC8); 
    OLED_WriteCmd(0xDA); 
    OLED_WriteCmd(0x12);
    OLED_WriteCmd(0x81); 
    OLED_WriteCmd(0xCF);
    OLED_WriteCmd(0xD9); 
    OLED_WriteCmd(0xF1);
    OLED_WriteCmd(0xDB); 
    OLED_WriteCmd(0x40);
    OLED_WriteCmd(0xA4); 
    OLED_WriteCmd(0xA6); 
    OLED_WriteCmd(0xAF); 
    OLED_Clear();
}

void OLED_Clear(void) {
    for (uint8_t i = 0; i < 8; i++) {
        OLED_WriteCmd(0xB0 + i);
        OLED_WriteCmd(0x00);
        OLED_WriteCmd(0x10);
        for (uint8_t n = 0; n < 128; n++) OLED_WriteData(0x00);
    }
}

void OLED_ShowChar(uint8_t x, uint8_t y, const uint8_t (*font_array)[16], uint8_t font_idx) {
    OLED_WriteCmd(0xB0 + y);
    OLED_WriteCmd(((x & 0xF0) >> 4) | 0x10);
    OLED_WriteCmd(x & 0x0F);
    for (int i = 0; i < 8; i++) OLED_WriteData(font_array[font_idx][i]);
    
    OLED_WriteCmd(0xB0 + y + 1);
    OLED_WriteCmd(((x & 0xF0) >> 4) | 0x10);
    OLED_WriteCmd(x & 0x0F);
    for (int i = 0; i < 8; i++) OLED_WriteData(font_array[font_idx][i + 8]);
}

void OLED_ShowChinese(uint8_t x, uint8_t y, const uint8_t (*font_array)[32], uint8_t font_idx) {
    OLED_WriteCmd(0xB0 + y);
    OLED_WriteCmd(((x & 0xF0) >> 4) | 0x10);
    OLED_WriteCmd(x & 0x0F);
    for (uint8_t i = 0; i < 16; i++) OLED_WriteData(font_array[font_idx][i]);
    
    OLED_WriteCmd(0xB0 + y + 1);
    OLED_WriteCmd(((x & 0xF0) >> 4) | 0x10);
    OLED_WriteCmd(x & 0x0F);
    for (uint8_t i = 0; i < 16; i++) OLED_WriteData(font_array[font_idx][i + 16]);
}

uint8_t OLED_Get_Center_X(uint8_t text_len) {
    uint16_t total_width = text_len * FONT_WIDTH;
    if(total_width >= OLED_WIDTH) return 0;
    return (OLED_WIDTH - total_width) / 2;
}

void OLED_Show_Normal_Line1(void) {
    uint8_t start_x = OLED_Get_Center_X(TEXT1_LEN);
    for(uint8_t i = 0; i < TEXT1_LEN; i++) {
        OLED_ShowChinese(start_x + i*FONT_WIDTH, 0, Font_Text1, i);
    }
}

void OLED_Show_Normal_Line2(void) {
    uint8_t show_num = current_img_index + 1;
    OLED_ShowChinese(16, 2, Font_ImageLine, 0);  
    OLED_ShowChar(32, 2, Font_ASCII, NUM_MAP[show_num-1]);  
    OLED_ShowChinese(48, 2, Font_ImageLine, 1);  
    OLED_ShowChinese(64, 2, Font_ImageLine, 2);  
    OLED_ShowChinese(80, 2, Font_ImageLine, 3);  
}

void OLED_Show_Normal_Line3(void) {
    OLED_ShowChinese(16, 4, Font_MusicLine, 0);  
    OLED_ShowChinese(32, 4, Font_MusicLine, 1);  
    OLED_ShowChinese(48, 4, Font_MusicLine, 2);  
    
    if(music_status == MUSIC_PLAYING) {
        OLED_ShowChinese(64, 4, Font_MusicLine, 3);
    } else {
        OLED_ShowChinese(64, 4, Font_MusicLine, 4);
    }
}

void OLED_Show_Normal_Line4(void) {
    OLED_ShowChinese(0, 6, Font_SafeLine, 0);  
    OLED_ShowChinese(16, 6, Font_SafeLine, 1); 
    OLED_ShowChinese(32, 6, Font_SafeLine, 2); 
    OLED_ShowChinese(48, 6, Font_SafeLine, 3); 
    OLED_ShowChinese(64, 6, Font_SafeLine, 4); 
    OLED_ShowChinese(80, 6, Font_SafeLine, 5); 
}

void OLED_Show_SafeMode_Text2_AutoWrap(void) {
    uint8_t x = 0;
    uint8_t y = 0;
    
    for(uint8_t i = 0; i < TEXT2_LEN; i++) {
        OLED_ShowChinese(x, y, Font_Text2, i);
        x += FONT_WIDTH;
        
        if(x >= OLED_WIDTH) {
            x = 0;
            y += 2;
            if(y >= OLED_HEIGHT/8) break;
        }
    }
}

void OLED_Show_Normal_Mode(void) {
    OLED_Clear();
    OLED_Show_Normal_Line1();
    OLED_Show_Normal_Line2();
    OLED_Show_Normal_Line3();
    OLED_Show_Normal_Line4();
}

void OLED_Show_Safe_Mode(void) {
    OLED_Clear();
    OLED_Show_SafeMode_Text2_AutoWrap();
}
void MP3_Send_Cmd(uint8_t cmd, uint8_t *data, uint8_t data_len) {
    uint8_t send_buf[32] = {0};
    uint8_t idx = 0;
    uint8_t check_sum = 0;
    
    send_buf[idx++] = MP3_START_CODE;
    uint8_t frame_len = 7 + data_len;
    send_buf[idx++] = frame_len;
    send_buf[idx++] = (MP3_DEV_ADDR >> 8) & 0xFF;
    send_buf[idx++] = MP3_DEV_ADDR & 0xFF;
    send_buf[idx++] = cmd;
    
    for(uint8_t i=0; i<data_len; i++) {
        send_buf[idx++] = data[i];
    }
    
    for(uint8_t i=0; i<idx; i++) {
        check_sum += send_buf[i];
    }
    send_buf[idx++] = check_sum;
    send_buf[idx++] = MP3_END_CODE;
    
    HAL_UART_Transmit(MP3_UART, send_buf, idx, 100);
}

void MP3_Play(void) {
    uint8_t data[2] = {0x00, 0x01}; 
    MP3_Send_Cmd(0x07, data, 2);
    music_status = MUSIC_PLAYING;
}

void MP3_Pause(void) {
    MP3_Send_Cmd(0x03, NULL, 0);
    music_status = MUSIC_PAUSE;
}

void MP3_Stop(void) {
    MP3_Send_Cmd(0x04, NULL, 0);
    music_status = MUSIC_STOP;
}

void HAL_UART_RxCpltCallback(UART_HandleTypeDef *huart) {
    if(huart->Instance == USART2) {
        mp3_rx_flag = 1;
    }
}
void Key_Scan(void) {
    static uint32_t key_last_tick = 0;
    if(HAL_GetTick() - key_last_tick < 20) return;
    key_last_tick = HAL_GetTick();
    if(safe_mode_flag == 1) {
        if(READ_KEY_UP() == GPIO_PIN_RESET) {
            current_img_index = (current_img_index == 0) ? 1 : 0;
            uint32_t img_addr = (uint32_t)current_img_index * SINGLE_IMG_SIZE;
            Display_Image_From_Flash(img_addr);
            OLED_Show_Safe_Mode();
            while(READ_KEY_UP() == GPIO_PIN_RESET);
        }
        if(READ_KEY_DOWN() == GPIO_PIN_RESET) {
            current_img_index = (current_img_index == 1) ? 0 : 1;
            uint32_t img_addr = (uint32_t)current_img_index * SINGLE_IMG_SIZE;
            Display_Image_From_Flash(img_addr);
            OLED_Show_Safe_Mode();
            while(READ_KEY_DOWN() == GPIO_PIN_RESET);
        }
        return; 
    }
    if(READ_KEY_UP() == GPIO_PIN_RESET) {
        current_img_index = (current_img_index == 0) ? (TOTAL_IMAGES - 1) : (current_img_index - 1);
        uint32_t img_addr = (uint32_t)current_img_index * SINGLE_IMG_SIZE;
        Display_Image_From_Flash(img_addr);
        OLED_Show_Normal_Mode();
        while(READ_KEY_UP() == GPIO_PIN_RESET);
    }

    if(READ_KEY_DOWN() == GPIO_PIN_RESET) {
        current_img_index = (current_img_index + 1) % TOTAL_IMAGES;
        uint32_t img_addr = (uint32_t)current_img_index * SINGLE_IMG_SIZE;
        Display_Image_From_Flash(img_addr);
        OLED_Show_Normal_Mode();
        while(READ_KEY_DOWN() == GPIO_PIN_RESET);
    }
    if(READ_KEY_MUSIC() == GPIO_PIN_RESET) {
        if(music_status == MUSIC_PLAYING) {
            MP3_Pause();
        } else {
            MP3_Play();
        }
        OLED_Show_Normal_Mode();
        while(READ_KEY_MUSIC() == GPIO_PIN_RESET);
    }
    if(READ_KEY_SAFE() == GPIO_PIN_RESET) {
        safe_mode_flag = 1;
        MP3_Stop(); 
        current_img_index = 0;
        uint32_t img_addr = (uint32_t)current_img_index * SINGLE_IMG_SIZE;
        Display_Image_From_Flash(img_addr);
        OLED_Show_Safe_Mode();
        while(READ_KEY_SAFE() == GPIO_PIN_RESET);
    }
}
/* USER CODE END 0 */

int main(void)
{
  HAL_Init();
  SystemClock_Config();
  MX_GPIO_Init();
  MX_DMA_Init();
  MX_SPI1_Init();
  MX_SPI2_Init();
  MX_I2C1_Init();
  MX_USART2_UART_Init();

  /* USER CODE BEGIN 2 */
  LCD_Init();
  OLED_Init();
  HAL_Delay(100);
  
  Display_Image_From_Flash(0);
  current_img_index = 0;
  OLED_Show_Normal_Mode();
  
  HAL_UART_Receive_DMA(&huart2, mp3_rx_buf, MP3_RX_BUF_LEN);
  /* USER CODE END 2 */

  while (1)
  {
    Key_Scan();
  }
}

void SystemClock_Config(void)
{
  RCC_OscInitTypeDef RCC_OscInitStruct = {0};
  RCC_ClkInitTypeDef RCC_ClkInitStruct = {0};

  __HAL_RCC_PWR_CLK_ENABLE();
  __HAL_PWR_VOLTAGESCALING_CONFIG(PWR_REGULATOR_VOLTAGE_SCALE1);

  RCC_OscInitStruct.OscillatorType = RCC_OSCILLATORTYPE_HSI;
  RCC_OscInitStruct.HSIState = RCC_HSI_ON;
  RCC_OscInitStruct.HSICalibrationValue = RCC_HSICALIBRATION_DEFAULT;
  RCC_OscInitStruct.PLL.PLLState = RCC_PLL_ON;
  RCC_OscInitStruct.PLL.PLLSource = RCC_PLLSOURCE_HSI;
  RCC_OscInitStruct.PLL.PLLM = 8;
  RCC_OscInitStruct.PLL.PLLN = 168;
  RCC_OscInitStruct.PLL.PLLP = RCC_PLLP_DIV2;
  RCC_OscInitStruct.PLL.PLLQ = 4;
  if (HAL_RCC_OscConfig(&RCC_OscInitStruct) != HAL_OK)
  {
    Error_Handler();
  }

  RCC_ClkInitStruct.ClockType = RCC_CLOCKTYPE_HCLK|RCC_CLOCKTYPE_SYSCLK
                              |RCC_CLOCKTYPE_PCLK1|RCC_CLOCKTYPE_PCLK2;
  RCC_ClkInitStruct.SYSCLKSource = RCC_SYSCLKSOURCE_PLLCLK;
  RCC_ClkInitStruct.AHBCLKDivider = RCC_SYSCLK_DIV1;
  RCC_ClkInitStruct.APB1CLKDivider = RCC_HCLK_DIV4;
  RCC_ClkInitStruct.APB2CLKDivider = RCC_HCLK_DIV2;

  if (HAL_RCC_ClockConfig(&RCC_ClkInitStruct, FLASH_LATENCY_5) != HAL_OK)
  {
    Error_Handler();
  }
}

void Error_Handler(void)
{
  __disable_irq();
  while (1)
  {
  }
}